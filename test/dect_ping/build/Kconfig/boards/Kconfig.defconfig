## test/dect_ping/build/Kconfig/boards/Kconfig.defconfig
```kconfig
# Load Zephyr board defconfig descriptions.
osource "C:/ncs/v3.0.0/zephyr/boards/nordic/nrf9151dk/Kconfig.defconfig"
```

## test/dect_ping/build/Kconfig/boards/Kconfig.nrf9151dk
```kconfig
# Load board Kconfig descriptions.
osource "C:/ncs/v3.0.0/zephyr/boards/nordic/nrf9151dk/Kconfig.nrf9151dk"
```
